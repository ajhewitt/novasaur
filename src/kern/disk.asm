;
; June 15, 2021
;
        .PROJECT        disk.com
;
ORIGIN  EQU     0FE00H
STACK   EQU     0FD00H

CMDSND	EQU	07EDH
YIELD	EQU	08EDH
RECRECV	EQU	09EDH
RECXFER	EQU	0AEDH
RECSEND	EQU	0BEDH

        .ORG    ORIGIN
START:  LXI     SP,STACK
        DW	YIELD
PROC:   PUSH    D       ;SAVE TRK/SEC
	MOV	A,E
	RRC             ;ROTATE*3
	RRC
	RRC
	ANI	0E0H    ;CLEAR LOWER 5 BITS
	MOV	E,A
	XCHG            ;INTO HL
	DAD	H       ;DOUBLE HL*2
	DAD	H
	PUSH	H       ;SAVE DE
	LXI	H, TABLE
	MVI	D,0
	MOV	A,C	;A=CMD
	CPI	03H	;LIMIT CMD<=3
	JC      START   ;SKIP HIGH CMD
	ADD	A	;A*=2
	MOV	E,A	;OFFSET
	DAD	D	;ADD TO TABLE
	MOV	E,M	;LOW BYTE
	INX	H
	MOV	D,M	;HIGH BYTE
	XCHG		;INTO HL
	POP	D       ;LOAD DE
	PCHL		;GO THERE
;
; KERNEL GETS RECORD
; - COPY FROM MEM [DE] TO BUFFER
; - SEND PUT COMMAND
;
GET:	DW	RECSEND	;COPY FROM MEM
        MVI     C,2     ;CMD PUT
        POP     D       ;LOAD TRK/SEC
        DW      CMDSND  ;SEND PUT
	JMP	PROC
;
; KERNEL PUTS RECORD
; - COPY FROM BUFFER TO MEM [DE]
; - SEND RETURN
;
PUT:	DW	RECRECV	;COPY TO MEM
        MVI     C,1     ;CMD RET
        POP     D       ;LOAD TRK/SEC
        DW      CMDSND  ;SEND RET
	JMP	PROC
;
; COMMAND JUMP VECTOR TABLE
;
TABLE:  DW      START
        DW      START
        DW      GET
        DW      PUT
